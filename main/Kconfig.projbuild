## main/Kconfig.projbuild
```kconfig
menu "homepost configuration"

    menu "BT Options"
        config HOMEPOST_BT_DEV_NAME
            string "BT device name"
            default "homepost"

        config HOMEPOST_BT_INQ_LEN
            int "BT inquiry length"
            default 30

        config HOMEPOST_PRINT_BLE_DEVICE_NAME
            bool "Print BLE device name"
            default n
    endmenu

    menu "Scanner Options"

        config HOMEPOST_SCAN_USE_RSSI_FILTER
            bool "Use RSSI filter"
            default n

        config HOMEPOST_SCAN_RSSI_THRESHOLD
            int "RSSI threshold"
            default -90
            depends on HOMEPOST_SCAN_USE_RSSI_FILTER

        config HOMEPOST_SCAN_MAJOR_FILTER
            int "Major filter"
            default 100

        config HOMEPOST_SCAN_MINOR_FILTER
            int "Minor filter"
            default 40004

        config HOMEPOST_SCAN_TIMEOUT_MINUTES
            int "Scan timeout (minutes)"
            default 2
    endmenu

    menu "Storage Configuration"
        config HOMEPOST_WIFI_CREDENTIALS_STORAGE_KEY
            string "WiFi Credentials Storage Key"
            default "wifi_crds"
            help
                Key used to store the WiFi credentials in the NVS storage.

        config HOMEPOST_BEACON_PUBLISH_INTERVAL_STORAGE_KEY
            string "Beacon Publish Interval Storage Key"
            default "beacon_pub_int"
            help
                Key used to store the Beacon Publish Interval in the NVS storage.

        config HOMEPOST_MQTT_CLIENT_ID_STORAGE_KEY
            string "MQTT Client ID Storage Key"
            default "mqtt_cl_id"
            help
                Key used to store the MQTT Client ID in the NVS storage.

        config HOMEPOST_MQTT_BROKER_STORAGE_KEY
            string "Token Storage Key"
            default "mqtt_brkr"
            help
                Key used to store the MQTT Broker in the NVS storage.

        config HOMEPOST_MQTT_PORT_STORAGE_KEY
            string "MQTT Port Storage Key"
            default "mqtt_port"
            help
                Key used to store the MQTT Port in the NVS storage.

        config HOMEPOST_MQTT_TOPIC_STORAGE_KEY
            string "MQTT Topic Storage Key"
            default "mqtt_topic"
            help
                Key used to store the MQTT Topic in the NVS storage.

        config HOMEPOST_MQTT_USERNAME_STORAGE_KEY
            string "MQTT Username Storage Key"
            default "mqtt_usr"
            help
                Key used to store the MQTT Username in the NVS storage.

        config HOMEPOST_MQTT_PASSWORD_STORAGE_KEY
            string "MQTT Password Storage Key"
            default "mqtt_pwd"
            help
                Key used to store the MQTT Password in the NVS storage.
    endmenu

    menu "WiFi Configuration"
        config HOMEPOST_WIFI_SOFTAP_SSID
            string "Soft AP WiFi SSID"
            default "HOMEPOST"
            help
                SSID (network name) for the example to connect to.
    
        config HOMEPOST_WIFI_SOFTAP_PASSWORD
            string "Soft AP WiFi Password"
            default "12345678"
            help
                WiFi password (WPA or WPA2) for the example to use.
                Can be left blank if the network has no security set.
    
        config HOMEPOST_WIFI_SOFTAP_CHANNEL
            int "Soft AP WiFi Channel"
            default 1
            help
                WiFi channel for the Soft AP use.
    
        config HOMEPOST_WIFI_SOFTAP_MAX_CONNECTIONS
            int "Soft AP Max Connections"
            default 1
            help
                Maximum number of stations that can be connected to the Soft AP.

        config HOMEPOST_WIFI_SOFTAP_HOSTNAME
            string "Soft AP Hostname"
            default "HOMEPOST"
            help
                Hostname for the Soft AP.

        config HOMEPOST_WIFI_STA_MAX_RETRIES
            int "WiFi STA Max Retries"
            default 5
            help
                Maximum number of retries to connect to the WiFi network.

        config HOMEPOST_WIFI_RECONNECTION_TIMER_PERIOD_US
            int "WiFi Reconnection Timer Period (us)"
            default 180000000
            help
                Period of the reconnection timer in microseconds.
                This is the time between reconnection attempts.
                The default value is 60 seconds.
    endmenu

    menu "HTTP Server Configuration"
        config HOMEPOST_HTTP_SERVER_PORT
            int "HTTP Server Port"
            default 80
            help
                Port for the HTTP server to listen on.

        config HOMEPOST_RESTART_DELAY_MICROSECONDS
            int "Restart Delay Microseconds"
            default 3000000
            help
                Restart delay in microseconds.
    endmenu

    menu "MQTT Configuration"
        config HOMEPOST_MQTT_BROKER
            string "MQTT Broker"
            default "mqtt.eclipse.org"
            help
                MQTT broker to connect to.

        config HOMEPOST_MQTT_PORT
            int "MQTT Port"
            default 1883
            help
                MQTT port to connect to.

        config HOMEPOST_MQTT_TOPIC
            string "MQTT Topic"
            default "homepost"
            help
                MQTT topic to publish to.

        config HOMEPOST_MQTT_PUBLISH_QUEUE_SIZE
            int "MQTT Publish Queue Size"
            default 10
            help
                Size of the MQTT publish queue.
    endmenu

    menu "Geiger counter Configuration"
        config HOMEPOST_GEIGER_COUNTER_TIMER_PERIOD_MS
            int "Geiger Counter Timer Period (ms)"
            default 60000
            help
                Period of the Geiger counter timer in milliseconds.
                This is the time between updates of the CPM value.

        config HOMEPOST_GEIGER_COUNTER_CPM_HISTORY_DEPTH
            int "Geiger Counter CPM History Depth"
            default 5
            help
                Depth of the CPM history buffer.

        config HOMEPOST_GEIGER_COUNTER_CONVERSION_FACTOR
            int "Geiger Counter Conversion Factor (1e6)"
            default 3320
            help
                Conversion factor to convert counts to CPM.
    endmenu
endmenu
```
